## vnext_prototype/guest_iwdt_espidf/sdkconfig.defaults
```kconfig
CONFIG_ESP_INT_WDT=y
CONFIG_ESP_INT_WDT_CHECK_CPU1=y
CONFIG_ESP_INT_WDT_TIMEOUT_MS=300
CONFIG_FREERTOS_UNICORE=n
CONFIG_ESP32_DEFAULT_CPU_FREQ_240=y
```
